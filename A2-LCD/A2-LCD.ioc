# file: A2-LCD.ioc
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Mcu.Family=STM32L4
Mcu.Name=STM32L476R(C-E-G)Tx
Mcu.Package=LQFP64
NVIC.PriorityGroup=NVIC_PRIORITYGROUP_4
ProjectManager.HeapSize=0x200
ProjectManager.StackSize=0x400
ProjectManager.TargetToolchain=STM32CubeIDE
RCC.HSE_VALUE=8000000
RCC.HSI_VALUE=16000000
RCC.LSE_VALUE=32768
RCC.MSI_VALUE=4000000
RCC.VCOOutputFreq_Value=32000000
board=custom

// file: Core/Src/main.c
/* USER CODE BEGIN Header */
/**
  ******************************************************************************
  * @file           : main.c
  * @brief          : Main program body
  ******************************************************************************
  * @attention
  *
  * Copyright (c) 2024 STMicroelectronics.
  * All rights reserved.
  *
  * This software is licensed under terms that can be found in the LICENSE file
  * in the root directory of this software component.
  * If no LICENSE file comes with this software, it is provided AS-IS.
  *
  ******************************************************************************
  */
/* USER CODE END Header */
#include "main.h"

void SystemClock_Config(void);
void LCD_init(void);
void LCD_write(uint8_t command, uint8_t mode);

int main(void)
{

  /* MCU Configuration--------------------------------------------------------*/

  /* Reset of all peripherals, Initializes the Flash interface and the Systick. */
  HAL_Init();

  /* USER CODE BEGIN Init */
  RCC->AHB2ENR |= (RCC_AHB2ENR_GPIOCEN);

  //bank C as GPIO
  //C0-7 = DB0-7	/	C10 = EN, C11 = RS, C12 = RW
  GPIOC->MODER &= ~(GPIO_MODER_MODE0 | GPIO_MODER_MODE1 | GPIO_MODER_MODE2 | GPIO_MODER_MODE3 | GPIO_MODER_MODE4 |
		  GPIO_MODER_MODE5 | GPIO_MODER_MODE6 | GPIO_MODER_MODE7 | GPIO_MODER_MODE10 | GPIO_MODER_MODE11
		  | GPIO_MODER_MODE12);
  //set GPIOC to outputs
  GPIOC->MODER |= (GPIO_MODER_MODE0_0 | GPIO_MODER_MODE1_0 | GPIO_MODER_MODE2_0 | GPIO_MODER_MODE3_0 |
		  GPIO_MODER_MODE4_0 | GPIO_MODER_MODE5_0 | GPIO_MODER_MODE6_0 | GPIO_MODER_MODE7_0 | GPIO_MODER_MODE10_0
		  | GPIO_MODER_MODE11_0 | GPIO_MODER_MODE12_0);
  /* USER CODE END Init */

  /* Configure the system clock */
  SystemClock_Config();

  /* Initialize all configured peripherals */

  /* Infinite loop */
  /* USER CODE BEGIN WHILE */
  LCD_init();
  LCD_write('H', 1);
  LCD_write('e', 1);
  LCD_write('l', 1);
  LCD_write('l', 1);
  LCD_write('o', 1);
  LCD_write(' ', 1);
  LCD_write('W', 1);
  LCD_write('o', 1);
  LCD_write('r', 1);
  LCD_write('l', 1);
  LCD_write('d', 1);
  LCD_write(0xC0, 0); //Go to 2nd line
  LCD_write('A', 1);
  LCD_write('s', 1);
  LCD_write('s', 1);
  LCD_write('i', 1);
  LCD_write('g', 1);
  LCD_write('n', 1);
  LCD_write('m', 1);
  LCD_write('e', 1);
  LCD_write('n', 1);
  LCD_write('t', 1);
  LCD_write(' ', 1);
  LCD_write('3', 1);

  /* USER CODE END 3 */
}

void LCD_init(void){
  LCD_write(0x30, 0); //set function to 8 bits
  LCD_write(0x0F, 0); //turn on display, cursor, and blinking cursor
  LCD_write(0x01, 0); //clear display
  LCD_write(0x02, 0); //return home
  LCD_write(0x3C, 0); //set 2 line mode
}

void LCD_write(uint8_t command, uint8_t mode){
  // mode == 0 for init / mode == 1 for writing
//  int b0 = ((command & 1) != 0);
//  int b1 = ((command & 2) != 0);
//  int b2 = ((command & 4) != 0);
//  int b3 = ((command & 8) != 0);
//  int b4 = ((command & 16) != 0);
//  int b5 = ((command & 32) != 0);
//  int b6 = ((command & 64) != 0);
//  int b7 = ((command & 128) != 0);

  //set RS high and RW low for writing
  if (mode){
	  //not in init so set RS high
	  GPIOC->BSRR = (GPIO_PIN_11);
  } else {
	  //init so RS low
	  GPIOC->BRR = (GPIO_PIN_11);
  }
  //RW goes high
  GPIOC->BRR = (GPIO_PIN_12);
  //set DB0-7 to valid data
  GPIOC->ODR &= ~(0xff);
  GPIOC->ODR |= (0xff & command);

  HAL_Delay(5);
  //set EN high
  GPIOC->BSRR = (GPIO_PIN_10);
  HAL_Delay(5);
  GPIOC->BRR = (GPIO_PIN_10);
}

void SystemClock_Config(void)
{
  RCC_OscInitTypeDef RCC_OscInitStruct = {0};
  RCC_ClkInitTypeDef RCC_ClkInitStruct = {0};

  /** Configure the main internal regulator output voltage
  */
  if (HAL_PWREx_ControlVoltageScaling(PWR_REGULATOR_VOLTAGE_SCALE1) != HAL_OK)
  {
    Error_Handler();
  }

  /** Initializes the RCC Oscillators according to the specified parameters
  * in the RCC_OscInitTypeDef structure.
  */
  RCC_OscInitStruct.OscillatorType = RCC_OSCILLATORTYPE_MSI;
  RCC_OscInitStruct.MSIState = RCC_MSI_ON;
  RCC_OscInitStruct.MSICalibrationValue = 0;
  RCC_OscInitStruct.MSIClockRange = RCC_MSIRANGE_6;
  RCC_OscInitStruct.PLL.PLLState = RCC_PLL_NONE;
  if (HAL_RCC_OscConfig(&RCC_OscInitStruct) != HAL_OK)
  {
    Error_Handler();
  }

  /** Initializes the CPU, AHB and APB buses clocks
  */
  RCC_ClkInitStruct.ClockType = RCC_CLOCKTYPE_HCLK|RCC_CLOCKTYPE_SYSCLK
                              |RCC_CLOCKTYPE_PCLK1|RCC_CLOCKTYPE_PCLK2;
  RCC_ClkInitStruct.SYSCLKSource = RCC_SYSCLKSOURCE_MSI;
  RCC_ClkInitStruct.AHBCLKDivider = RCC_SYSCLK_DIV1;
  RCC_ClkInitStruct.APB1CLKDivider = RCC_HCLK_DIV1;
  RCC_ClkInitStruct.APB2CLKDivider = RCC_HCLK_DIV1;

  if (HAL_RCC_ClockConfig(&RCC_ClkInitStruct, FLASH_LATENCY_0) != HAL_OK)
  {
    Error_Handler();
  }
}

void Error_Handler(void)
{
  __disable_irq();
  while (1)
  {
  }
}
